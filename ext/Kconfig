## ext/Kconfig
```kconfig
# Kconfig - external source code configuration options

#
# Copyright (c) 2016 Linaro Ltd.
#
# SPDX-License-Identifier: Apache-2.0
#

menu "External Sources"

source "ext/hal/Kconfig"

endmenu
```

## lib/Kconfig
```kconfig
# Copyright (c) 2016 Intel Corporation
# SPDX-License-Identifier: Apache-2.0

source "lib/libc/Kconfig"

menu "Additional libraries"

source "lib/os/Kconfig"

endmenu
```
